## conf/layer.conf
```bitbake
# We have a conf and classes directory, add to BBPATH
BBPATH .= ":${LAYERDIR}"

# We have recipes-* directories, add to BBFILES
BBFILES += "${LAYERDIR}/recipes-*/*/*.bb \
            ${LAYERDIR}/recipes-*/*/*.bbappend"

BBFILE_COLLECTIONS += "meta-qtpyvcp"
BBFILE_PATTERN_meta-qtpyvcp = "^${LAYERDIR}/"
BBFILE_PRIORITY_meta-qtpyvcp = "6"

LAYERDEPENDS_meta-qtpyvcp = "core"
LAYERSERIES_COMPAT_meta-qtpyvcp = "honister"

PREFERRED_PROVIDER_virtual/kernel = "linux-intel-rt"
COMPATIBLE_MACHINE_intel-corei7-64 = "intel-corei7-64"
COMPATIBLE_MACHINE_quilt-native = "intel-corei7-64"
```

## conf/machine/hazzy-x86_64.conf
```bitbake
#@TYPE: Machine
#@NAME: Hazzy for x86_64 machines
#@DESCRIPTION: Hazzy Machine configuration for Generic x86_64

PREFERRED_VERSION_gcc-cross-${TARGET_ARCH} ?= "4.%"
GCCVERSION ?= "4.%"
SDKGCCVERSION ?= "4.%"
COMPATIBLE_MACHINE_genericx86-64 = genericx86-64
```
